## Kconfig
```kconfig
menuconfig RT_USING_ESP_HOSTED
    bool "Using esp-hosted for espressif"
    select RT_USING_WIFI
    select RT_USING_SAL
    select RT_USING_SPI
    default n

    if RT_USING_ESP_HOSTED

        config ESP_HOSTED_THREAD_PRIORITY
            int "The priority of the esp-hosted thread"
            range 0 32
            default 8

        config ESP_HOSTED_THREAD_STACK_SIZE
            int "The stack size of the esp-hosted thread"
            range 0 8192
            default 5120

        config ESP_HOSTED_SPI_THREAD_PRIORITY
            int "The priority of the esp-hosted SPI thread"
            range 0 32
            default 20

        config ESP_HOSTED_SPI_THREAD_STACK_SIZE
            int "The stack size of the esp-hosted SPI thread"
            range 0 4096
            default 1024

        config ESP_HOSTED_SPI_QUEUE_SIZE
            int "The size for esp-hosted SPI queue"
            range 0 32
            default 2

        config ESP_HOSTED_SPI_DEVICE_NAME
            string "Set the spi device name"
            default "esp-hosted"

        config ESP_HOSTED_SPI_BUS_NAME
            string "Set the spi bus name"
            default "spi1"

        config ESP_HOSTED_SPI_MAX_HZ
            int "Set the maximum spi frequency(Hz)"
            default 30000000

        choice
            prompt "Select the pin name or number"
            default ESP_HOSTED_USING_PIN_NAME

            config ESP_HOSTED_USING_PIN_NAME
                bool "Name"

            config ESP_HOSTED_USING_PIN_NUMBER
                bool "Number"
        endchoice

        if ESP_HOSTED_USING_PIN_NAME
            config ESP_HOSTED_SPI_CS_PIN_NAME
                string "Set the SPI CS pin name"
                default "PA.0"

            config ESP_HOSTED_DATA_READY_PIN_NAME
                string "Set the data ready pin name"
                default "PA.0"

            config ESP_HOSTED_HANDSHAKE_PIN_NAME
                string "Set the handshake pin name"
                default "PA.0"

            config ESP_HOSTED_RESET_PIN_NAME
                string "Set the reset pin name"
                default "PA.0"
        endif

        if ESP_HOSTED_USING_PIN_NUMBER
            config ESP_HOSTED_SPI_CS_PIN
                int "Set the SPI CS pin"
                default -1

            config ESP_HOSTED_DATA_READY_PIN
                int "Set the data ready pin"
                default -1

            config ESP_HOSTED_HANDSHAKE_PIN
                int "Set the handshake pin"
                default -1

            config ESP_HOSTED_RESET_PIN
                int "Set the reset pin"
                default -1
        endif

        config ESP_HOSTED_THREAD_INIT
            bool "Use thread initialization"
            default n

        if ESP_HOSTED_THREAD_INIT
            config ESP_HOSTED_INIT_THREAD_STACK_SIZE
                int "The stack size of the init thread"
                range 0 4096
                default 2048

            config ESP_HOSTED_INIT_THREAD_PRIORITY
                int "The priority of the init thread"
                range 0 32
                default 20
        endif

    endif
```

## esp/network_adapter/sdkconfig.defaults.esp32c3
```kconfig
CONFIG_ESP32_DEFAULT_CPU_FREQ_160=y
CONFIG_ESP32_DEFAULT_CPU_FREQ_MHZ=160
CONFIG_FREERTOS_UNICORE=y
CONFIG_SDIO_DAT2_DISABLED=

# BT Configuration
CONFIG_BT_ENABLED=y
CONFIG_BT_CONTROLLER_ONLY=y
CONFIG_BT_BLUEDROID_ENABLED=
CONFIG_BT_LE_SLEEP_ENABLE=y

CONFIG_ESP_SYSTEM_EVENT_TASK_STACK_SIZE=4096
CONFIG_ESP_WIFI_STATIC_RX_BUFFER_NUM=16
CONFIG_ESP_WIFI_DYNAMIC_RX_BUFFER_NUM=64
CONFIG_ESP_WIFI_DYNAMIC_TX_BUFFER_NUM=64
CONFIG_ESP_WIFI_TX_BA_WIN=32
CONFIG_ESP_WIFI_RX_BA_WIN=32
CONFIG_LWIP_TCPIP_RECVMBOX_SIZE=64
CONFIG_LWIP_TCP_SND_BUF_DEFAULT=65534
CONFIG_LWIP_TCP_WND_DEFAULT=65534
CONFIG_LWIP_TCP_RECVMBOX_SIZE=12
CONFIG_LWIP_TCP_ACCEPTMBOX_SIZE=12
```
